## conf/layer.conf
```bitbake
# We have a conf and classes directory, add to BBPATH
BBPATH .= ":${LAYERDIR}"

# We have recipes-* directories, add to BBFILES
BBFILES += "${LAYERDIR}/recipes-*/*/*.bb \
            ${LAYERDIR}/recipes-*/*/*.bbappend"

BBFILE_COLLECTIONS += "meta-gsoc-playground"
BBFILE_PATTERN_meta-gsoc-playground = "^${LAYERDIR}/"
BBFILE_PRIORITY_meta-gsoc-playground = "6"

LAYERDEPENDS_meta-gsoc-playground = "core"
LAYERSERIES_COMPAT_meta-gsoc-playground = "kirkstone"
```
